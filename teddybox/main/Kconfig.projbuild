## teddybox/main/Kconfig.projbuild
```kconfig
menu "TeddyBox"

config TEDDYBOX_OFFICIAL_CLOUD
    bool "Use the official Tonie cloud with original certificates"
    default n
    select MBEDTLS_HAVE_TIME
    select MBEDTLS_HAVE_TIME_DATE

config TEDDYBOX_CLOUD_HOST
    string "Cloud hostname"
    default "prod.de.tbs.toys" if TEDDYBOX_OFFICIAL_CLOUD
    default "teddycloud.jcarletto.com"

config TEDDYBOX_CLOUD_PORT
    int "Cloud HTTPS port"
    range 1 65535
    default 443 if TEDDYBOX_OFFICIAL_CLOUD
    default 8243

config TEDDYBOX_CERT_DIRECTORY
    string "Cloud certificate directory"
    default "/spiflash/cert"
    help
        Contains ca.der, client.der and private.der. DER and PEM are accepted.
        Official cloud mode requires the original box certificate and key,
        and its original server CA, rather than replacement TeddyCloud credentials.

choice AUDIO_DECODER_SUPPORT
    prompt "Audio Decoder"
    default AUDIO_SUPPORT_OPUS_DECODER
    help
        Select audio decoders to be included

config AUDIO_SUPPORT_TS_DECODER
    bool "ESP-TS-DECODER"

config AUDIO_SUPPORT_M4A_DECODER
    bool "ESP-M4A-DECODER"

config AUDIO_SUPPORT_MP3_DECODER
    bool "ESP-MP3-DECODER"

config AUDIO_SUPPORT_MP4_DECODER
    bool "ESP-MP4-DECODER"

config AUDIO_SUPPORT_AMRNB_DECODER
    bool "ESP-AMRNB-DECODER"

config AUDIO_SUPPORT_AMRWB_DECODER
    bool "ESP-AMRWB-DECODER"

config AUDIO_SUPPORT_WAV_DECODER
    bool "ESP-WAV-DECODER"

config AUDIO_SUPPORT_OPUS_DECODER
    bool "ESP-OPUS-DECODER"

config AUDIO_SUPPORT_OGG_DECODER
    bool "ESP-OGG-DECODER"

config AUDIO_SUPPORT_AAC_DECODER
    bool "ESP-AAC-DECODER"

config AUDIO_SUPPORT_FLAC_DECODER
    bool "ESP-FLAC-DECODER"

endchoice

endmenu
```

## teddybox/sdkconfig.defaults
```kconfig
CONFIG_IDF_CMAKE=y
CONFIG_IDF_TARGET_ARCH_XTENSA=y
CONFIG_IDF_TARGET="esp32s3"
CONFIG_IDF_TARGET_ESP32S3=y
CONFIG_IDF_FIRMWARE_CHIP_ID=0x0009
CONFIG_SDK_TOOLPREFIX="xtensa-esp32s3-elf-"


CONFIG_BOOTLOADER_OFFSET_IN_FLASH=0x0000
CONFIG_PARTITION_TABLE_OFFSET=0x9000

CONFIG_PARTITION_TABLE_CUSTOM=y
CONFIG_PARTITION_TABLE_CUSTOM_FILENAME="part.lst"
CONFIG_PARTITION_TABLE_FILENAME="part.lst"

CONFIG_TONIEBOX_ESP32_V1_6_C=y
CONFIG_AUDIO_BOARD_CUSTOM=y


CONFIG_ESPTOOLPY_BAUD_921600B=y
CONFIG_ESPTOOLPY_FLASHMODE="qio"
CONFIG_ESPTOOLPY_BAUD=921600
CONFIG_ESPTOOLPY_FLASHSIZE_8MB=y
CONFIG_ESPTOOLPY_FLASHSIZE="8MB"


CONFIG_BOOTLOADER_APP_TEST=y
CONFIG_BOOTLOADER_NUM_PIN_APP_TEST=20
CONFIG_BOOTLOADER_HOLD_TIME_GPIO=5

# Recover blocked application tasks and retain diagnostics in the existing partition.
CONFIG_ESP_TASK_WDT=y
CONFIG_ESP_TASK_WDT_PANIC=y
CONFIG_ESP_TASK_WDT_TIMEOUT_S=30
CONFIG_ESP_COREDUMP_ENABLE_TO_FLASH=y
CONFIG_ESP_COREDUMP_DATA_FORMAT_ELF=y
CONFIG_ESP_COREDUMP_CHECKSUM_CRC32=y

CONFIG_ESP_SYSTEM_PANIC_PRINT_REBOOT=y
```
